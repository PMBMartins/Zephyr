## west.yml
```yaml
manifest:
  version: 
  remotes:
    - name: zephyr
      url-base: https://github.com/zephyrproject-rtos
  projects:
    - name: zephyr
      remote: zephyr
      revision: main
      path: zephyr
  self:
    path: hello-world
```
